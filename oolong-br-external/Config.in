## oolong-br-external/Config.in
```kconfig
source "$BR2_EXTERNAL_OOLONG_PATH/package/cst-signatures/Config.in"
source "$BR2_EXTERNAL_OOLONG_PATH/package/gen-flash-bin/Config.in"
```

## oolong-br-external/configs/oolong_nitrogen8mm_rev2_defconfig
```kconfig
BR2_aarch64=y
BR2_PACKAGE_HOST_LINUX_HEADERS_CUSTOM_5_15=y
BR2_TOOLCHAIN_BUILDROOT_CXX=y
BR2_GLOBAL_PATCH_DIR="$(BR2_EXTERNAL_OOLONG_PATH)/board/nitrogen8mm_rev2/patches"
BR2_TARGET_GENERIC_ROOT_PASSWD="oolong"
BR2_TARGET_GENERIC_GETTY_PORT="ttymxc1"
BR2_ROOTFS_OVERLAY="$(BR2_EXTERNAL_OOLONG_PATH)/board/nitrogen8mm_rev2/overlay"
BR2_ROOTFS_POST_BUILD_SCRIPT="$(BR2_EXTERNAL_OOLONG_PATH)/board/nitrogen8mm_rev2/post-build.sh"
BR2_ROOTFS_POST_IMAGE_SCRIPT="$(BR2_EXTERNAL_OOLONG_PATH)/board/nitrogen8mm_rev2/post-image.sh"
BR2_LINUX_KERNEL=y
BR2_LINUX_KERNEL_CUSTOM_TARBALL=y
BR2_LINUX_KERNEL_CUSTOM_TARBALL_LOCATION="https://github.com/boundarydevices/linux/archive/bda340dd08cdce902a034e05ec44a3d31a54ebe7.tar.gz"
BR2_LINUX_KERNEL_DEFCONFIG="boundary"
BR2_LINUX_KERNEL_DTS_SUPPORT=y
BR2_LINUX_KERNEL_INTREE_DTS_NAME="freescale/imx8mm-nitrogen8mm freescale/imx8mm-nitrogen8mm-m4 freescale/imx8mm-nitrogen8mm_rev2 freescale/imx8mm-nitrogen8mm_rev2-m4 freescale/imx8mm-nitrogen8mm_som freescale/imx8mm-nitrogen8mm_som-m4"
BR2_LINUX_KERNEL_NEEDS_HOST_OPENSSL=y
BR2_PACKAGE_MMC_UTILS=y
BR2_PACKAGE_FREESCALE_IMX=y
BR2_PACKAGE_FREESCALE_IMX_PLATFORM_IMX8MM=y
BR2_PACKAGE_FIRMWARE_IMX=y
BR2_PACKAGE_UBOOT_TOOLS=y
BR2_PACKAGE_OPENSSH=y
BR2_PACKAGE_OPTEE_TEST=y
BR2_PACKAGE_MENDER=y
BR2_TARGET_ROOTFS_INITRAMFS=y
BR2_TARGET_ROOTFS_TAR=n
BR2_TARGET_ARM_TRUSTED_FIRMWARE=y
BR2_TARGET_ARM_TRUSTED_FIRMWARE_CUSTOM_TARBALL=y
BR2_TARGET_ARM_TRUSTED_FIRMWARE_CUSTOM_TARBALL_LOCATION="https://github.com/boundarydevices/imx-atf/archive/697a8319a3d89ffae16500a72aad0a10832fb48a.tar.gz"
BR2_TARGET_ARM_TRUSTED_FIRMWARE_PLATFORM="imx8mm"
BR2_TARGET_ARM_TRUSTED_FIRMWARE_BL31=y
BR2_TARGET_ARM_TRUSTED_FIRMWARE_BL32_OPTEE=y
BR2_TARGET_ARM_TRUSTED_FIRMWARE_ADDITIONAL_VARIABLES="DEBUG_CONSOLE=1"
BR2_TARGET_OPTEE_OS=y
BR2_TARGET_OPTEE_OS_CUSTOM_TARBALL=y
BR2_TARGET_OPTEE_OS_CUSTOM_TARBALL_LOCATION="https://source.codeaurora.org/external/imx/imx-optee-os/snapshot/imx-optee-os-lf-5.15.32-2.0.0.tar.gz"
BR2_TARGET_OPTEE_OS_NEEDS_PYTHON_CRYPTOGRAPHY=y
BR2_TARGET_OPTEE_OS_PLATFORM="imx-mx8mmevk"
BR2_TARGET_UBOOT=y
BR2_TARGET_UBOOT_BUILD_SYSTEM_KCONFIG=y
BR2_TARGET_UBOOT_CUSTOM_TARBALL=y
BR2_TARGET_UBOOT_CUSTOM_TARBALL_LOCATION="https://github.com/boundarydevices/u-boot/archive/abfdd085aafa53de7ef168a114eac9a15386c23a.tar.gz"
BR2_TARGET_UBOOT_USE_CUSTOM_CONFIG=y
BR2_TARGET_UBOOT_CUSTOM_CONFIG_FILE="$(BR2_EXTERNAL_OOLONG_PATH)/board/nitrogen8mm_rev2/uboot-v2022.04.config"
BR2_PACKAGE_HOST_E2FSPROGS=y
BR2_PACKAGE_HOST_IMX_MKIMAGE=y
BR2_PACKAGE_HOST_MENDER_ARTIFACT=y
BR2_PACKAGE_HOST_UUU=y
BR2_PACKAGE_CST_SIGNATURES=n
BR2_PACKAGE_GEN_FLASH_BIN=y
```

## oolong-br-external/package/cst-signatures/Config.in
```kconfig
config BR2_PACKAGE_CST_SIGNATURES
    bool "Code Signing Tool (CST) Signatures"
    help
        Sign generated images using the code signing tool for HAB-enabled boards.
```

## oolong-br-external/package/gen-flash-bin/Config.in
```kconfig
config BR2_PACKAGE_GEN_FLASH_BIN
    bool "Generate flash.bin"
    help
        Generate flash.bin with bootloader, DDR firmware, OP-TEE, etc.
```
